## firmware/esp32-ui/main/Kconfig.projbuild
```kconfig
menu "POV Display Configuration"

    config ESP_WIFI_SSID
        string "WiFi SSID"
        default "POV-Display"
        help
            Name of the WiFi network the board broadcasts.

    config ESP_WIFI_PASSWORD
        string "WiFi Password"
        default "povdisplay"
        help
            WPA2 password for the board's WiFi network (min 8 characters).

    config ESP_WIFI_CHANNEL
        int "WiFi Channel"
        range 1 13
        default 1
        help
            WiFi channel to broadcast on.

    config ESP_MAX_STA_CONN
        int "Maximal STA connections"
        default 4
        range 1 15
        help
            Maximum number of devices allowed to connect at once.

    config MDNS_HOSTNAME
        string "mDNS hostname"
        default "pov"
        help
            The board is reachable at http://<hostname>.local instead of
            its raw IP, on devices that support mDNS (most phones/PCs).

    config ESP_STA_WIFI_SSID
        string "Existing WiFi SSID (STA test mode only)"
        default ""
        help
            Only used when WIFI_CONNECT_TO_EXISTING_AP is set to 1 in
            wifi_ap.c.

    config ESP_STA_WIFI_PASSWORD
        string "Existing WiFi password (STA test mode only)"
        default ""
        help
            Only used when WIFI_CONNECT_TO_EXISTING_AP is set to 1 in
            wifi_ap.c.

endmenu
```
